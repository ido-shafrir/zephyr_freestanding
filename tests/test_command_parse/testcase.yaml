## tests/test_command_parse/testcase.yaml
```yaml
tests:
  zephyr_freestanding.command_parse:
    platform_allow:
      - native_sim
      - qemu_cortex_m3
    timeout: 120
    tags: command_parse
```

## tests/test_event_log/testcase.yaml
```yaml
tests:
  app.event_log:
    platform_allow:
      - native_sim
      - qemu_x86
    tags: event_log
    timeout: 180
```

## tests/test_rest_logic/testcase.yaml
```yaml
tests:
  zephyr_freestanding.rest_logic:
    platform_allow:
      - native_sim
      - qemu_cortex_m3
    timeout: 120
    tags: rest_logic
```

## tests/test_time_service/testcase.yaml
```yaml
tests:
  app.time_service:
    platform_allow:
      - native_sim
      - qemu_x86
    tags: time_service
    timeout: 240
```

## tests/test_utils/testcase.yaml
```yaml
tests:
  zephyr_freestanding.utils:
    platform_allow:
      - native_sim
      - qemu_cortex_m3
    timeout: 240
    tags: utils
```
